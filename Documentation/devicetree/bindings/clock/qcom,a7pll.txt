## Documentation/devicetree/bindings/clock/qcom,a7pll.txt
```
Qualcomm MSM8909 A7 PLL Binding
--------------------------------
The A7 PLL on MSM8909 platforms is the main CPU PLL used used for frequencies
above 1GHz.

Required properties :
- compatible : Shall contain only one of the following:

		"qcom,msm8909-a7pll"

- reg : shall contain base register location and length

- #clock-cells : must be set to <0>

Example:

	a7pll: clock@b016000 {
		compatible = "qcom,msm8909-a7pll";
		reg = <0xb016000 0x40>;
		#clock-cells = <0>;
	};
```
